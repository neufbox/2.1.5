## openwrt/target/linux/brcm63xx/files-2.6.21/arch/mips/bcm63xx/Kconfig
```kconfig
# Kernel and Driver configuration for Broadcom Commengine ADSL board
choice
	prompt "Broadcom Commengine ADSL board"
	depends on MIPS_BRCM
	default BCM96348
	help
	  Select different Broadcom ADSL board

config BCM96338
	bool "96338 ADSL board"
	select BCM63XX_CPU_6338
	select DMA_NONCOHERENT

config BCM96348
	bool "96348 ADSL board"
	select BCM63XX_CPU_6348
	select DMA_NONCOHERENT

config BCM96358
	bool "96358 ADSL board"
	select BCM63XX_CPU_6358
	select DMA_NONCOHERENT

config BCM96368
	bool "96368 ADSL board"
	select DMA_NONCOHERENT

config BCM96816
	bool "96816 ADSL board"
	select DMA_NONCOHERENT

endchoice

config BCM_BOARD
	bool "Support for Broadcom Board"
	depends on BCM96338 || BCM96348 || BCM96358 || BCM96368 || BCM96816

source "arch/mips/bcm63xx/boards/Kconfig"

config BCM_PKTFLOW
	tristate "Support for Broadcom Packet Flow Cache"
	depends on BCM96368 || BCM96358 || BCM96348
	help
		Say 'M' to include support for Broadcom Packet Flow Cache.
		Static compile not supported.

config BCM_PKTCMF
	tristate "Support for Packet CMF"
	depends on BCM96368
	help
		Say 'M' to include support for Packet CMF.
		Static compile not supported.

config BCM_ENET
	tristate "Support for Ethernet"
	depends on BCM96338 || BCM96348 || BCM96358 || BCM96368

config BCM_GPON
	tristate "Support for GPON"
	depends on BCM96338 || BCM96348 || BCM96358 || BCM96368

config BCM_USB
	tristate "Support for USB"
	depends on BCM96338 || BCM96348 || BCM96358 || BCM96368

config BCM_ISDN
	tristate "Support for ISDN"
	depends on BCM96358 || BCM96368

config BCM_WLAN
	tristate "Support for Wireless"
	depends on BCM96338 || BCM96348 || BCM96358 || BCM96368

config BCM_PCI
	bool "Support for PCI"
	depends on BCM96338 || BCM96348 || BCM96358 || BCM96368
	select PCI

config BCM_ATMAPI
	tristate "Support for ATM"
	depends on BCM96338 || BCM96348 || BCM96358 || BCM96368

config BCM_XTMCFG
	tristate "Support for XTM"
	depends on BCM96338 || BCM96348 || BCM96358 || BCM96368

config BCM_ATMTEST
	tristate "Support for ATM Diagnostic"
	depends on BCM96338 || BCM96348 || BCM96358 || BCM96368

config BCM_ADSL
	tristate "Support for ADSL"
	depends on BCM96338 || BCM96348 || BCM96358 || BCM96368

config BCM_ENDPOINT
	tristate "Support for VOICE"
	depends on BCM96338 || BCM96348 || BCM96358 || BCM96368

config BCM_BCMPROF
	tristate "Support for profiling"
	depends on BCM96338 || BCM96348 || BCM96358 || BCM96368

config BCM_BCMDSP
	tristate "Support for DSP application"
	depends on BCM96338 || BCM96348 || BCM96358 || BCM96368

config BCM_PROCFS
	tristate "Support for PROCFS"
	depends on BCM96338 || BCM96348 || BCM96358 || BCM96368

config BCM_SECURITY
	tristate "Support for SECURITY"
	depends on BCM96338 || BCM96348 || BCM96358 || BCM96368

config BCM_HPNA
	tristate "Support for HPNA"
	depends on BCM96338 || BCM96348 || BCM96358 || BCM96368

config BCM_P8021AG
	tristate "Support for IEEE P8021.ag"
	depends on BCM96338 || BCM96348 || BCM96358 || BCM96368

config BCM_SMUX
	tristate "Implementation index for RFC2684 Services"
	depends on BCM96338 || BCM96348 || BCM96358 || BCM96368

config BCM_BOARD_IMPL
	int "Implementation index for ADSL Board"
	depends on BCM96338 || BCM96348 || BCM96358 || BCM96368 || BCM96816

config BCM_PKTFLOW_IMPL
	int "Implementation index for Broadcom Flow Cache"
	depends on BCM96368 || BCM96358 || BCM96348

config BCM_PKTCMF_IMPL
	int "Implementation index for Packet CMF"
	depends on BCM96368

config BCM_ENET_IMPL
	int "Implementation index for Ethernet"
	depends on BCM96338 || BCM96348 || BCM96358 || BCM96368

config BCM_GPON_IMPL
	int "Implementation index for GPON"
	depends on BCM96338 || BCM96348 || BCM96358 || BCM96368

config BCM_USB_IMPL
	int "Implementation index for USB"
	depends on BCM96338 || BCM96348 || BCM96358 || BCM96368

config BCM_ISDN_IMPL
	int "Implementation index for ISDN"
	depends on BCM96358 || BCM96368

config BCM_WLAN_IMPL
	int "Implementation index for WIRELESS"
	depends on BCM96338 || BCM96348 || BCM96358 || BCM96368

config BCM_ATMAPI_IMPL
	int "Implementation index for ATM"
	depends on BCM96338 || BCM96348 || BCM96358 || BCM96368

config BCM_XTMCFG_IMPL
	int "Implementation index for XTMCFG"
	depends on BCM96338 || BCM96348 || BCM96358 || BCM96368

config BCM_XTMRT_IMPL
  	int "Implementation index for XTMRT"
	depends on BCM96338 || BCM96348 || BCM96358 || BCM96368

config BCM_ATMTEST_IMPL
	int "Implementation index for ATM Diagnostic"
	depends on BCM96338 || BCM96348 || BCM96358 || BCM96368

config BCM_BLAA_IMPL
	int "Implementation index for BLAA"
	depends on BCM96338 || BCM96348 || BCM96358 || BCM96368

config BCM_ADSL_IMPL
	int "Implementation index for ADSL"
	depends on BCM96338 || BCM96348 || BCM96358 || BCM96368

config BCM_ENDPOINT_IMPL
	int "Implementation index for VOICE"
	depends on BCM96338 || BCM96348 || BCM96358 || BCM96368

config BCM_BCMPROF_IMPL
	int "Implementation index for DSP APPLICATION"
	depends on BCM96338 || BCM96348 || BCM96358 || BCM96368

config BCM_BCMDSP_IMPL
	int "Implementation index for PROFILING"
	depends on BCM96338 || BCM96348 || BCM96358 || BCM96368

config BCM_PROCFS_IMPL
	int "Implementation index for PROCFS"
	depends on BCM96338 || BCM96348 || BCM96358 || BCM96368

config BCM_SECURITY_IMPL
	int "Implementation index for SECURITY"
	depends on BCM96338 || BCM96348 || BCM96358 || BCM96368

config BCM_HPNA_IMPL
	int "Implementation index for HPNA"
	depends on BCM96338 || BCM96348 || BCM96358 || BCM96368

config BCM_P8021AG_IMPL
	int "Implementation index for IEEE P8021AG"
	depends on BCM96338 || BCM96348 || BCM96358 || BCM96368



config BCM63XX_CPU_6338
	bool

config BCM63XX_CPU_6348
	bool

config BCM63XX_CPU_6358
	bool
```

## openwrt/target/linux/brcm63xx/files-2.6.21/arch/mips/bcm63xx/boards/Kconfig
```kconfig
choice
	prompt "Board support"
	depends on BCM_BOARD
	default BOARD_BCM963XX

config BOARD_BCM963XX
       bool "Generic Broadcom 963xx boards"
       help

config BOARD_LIVEBOX
	bool "Inventel Livebox(es) boards"
	help
	  Boards using RedBoot.

config BOARD_NEUFBOX4
	bool "neufbox4 boards"
	select GENERIC_GPIO
	select GPIO_74HC164D
	help

endchoice

menu "neufbox4"
choice
	prompt "Select profile"
	depends on BOARD_NEUFBOX4

config NEUFBOX_MAIN
 	bool "Main image"
	depends on BOARD_NEUFBOX4

config NEUFBOX_RESCUE
 	bool "Rescue image"
	depends on BOARD_NEUFBOX4

endchoice

config NEUFBOX_ROBO_SWITCH
	bool "Add support for Neufbox Robo switch"
	depends on BOARD_NEUFBOX4
	default "y"
	help
	  This option add support for Broadcom Robo Switch 5395

config NEUFBOX_ETHTOOL
	bool "Add support for Neufbox ethtool"
	depends on BOARD_NEUFBOX4
	default "y"
	help
	  This option add support for Ethtool
endmenu
```

## openwrt/target/linux/octeon/image/Config.in
```kconfig
config CAVIUM_OCTEON_UBOOT
	bool "Build U-Boot bootloader"
	depends TARGET_cavium_octeon
	default y

config UBOOT_IPADDR
	string "IP Address for U-Boot"
	depends TARGET_cavium_octeon
	depends CAVIUM_OCTEON_UBOOT
	default "192.168.22.10"
	help
	  IP address of device to be used in U-Boot

config UBOOT_SERVERIP
	string "IP Address of TFTP server"
	depends TARGET_cavium_octeon
	depends CAVIUM_OCTEON_UBOOT
	default "192.168.22.20"
	help
	  IP address of TFTP server for U-Boot
```
